## boards/lora3a-h10/Kconfig
```kconfig
config BOARD
    default "lora3a-h10" if BOARD_LORA3A_H10

config BOARD_LORA3A_H10
    bool
    default y
    select CPU_MODEL_SAMR34J18B
    select HAS_PERIPH_ADC
    select HAS_PERIPH_I2C
    select HAS_PERIPH_RTC
    select HAS_PERIPH_RTT
    select HAS_PERIPH_SPI
    select HAS_PERIPH_TIMER
    select HAS_PERIPH_UART
    select HAS_RIOTBOOT

    select HAVE_SX1276
    select HAVE_SAUL_GPIO
```

## boards/lora3a-st02/Kconfig
```kconfig
config BOARD
    default "lora3a-dongle" if BOARD_LORA3A_DONGLE

config BOARD_LORA3A_DONGLE
    bool
    default y
    select CPU_MODEL_SAMR34J18B
    select HAS_PERIPH_ADC
    select HAS_PERIPH_I2C
    select HAS_PERIPH_RTC
    select HAS_PERIPH_RTT
    select HAS_PERIPH_SPI
    select HAS_PERIPH_TIMER
    select HAS_PERIPH_UART
    select HAS_RIOTBOOT
```
